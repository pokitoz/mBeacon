## mBeaconSrc/zephyr/KConfig
```kconfig
module = KBEACONMAIN
module-str = Main module log
source "${ZEPHYR_BASE}/subsys/logging/Kconfig.template.log_config"


source "Kconfig.zephyr"
```

## mBeaconSrc/zephyr/boards/arm/mBeacon/Kconfig.board
```kconfig
# nRF52 MBeacon board configuration

config BOARD_MBEACON
	bool "nRF52 DK NRF52832"
	depends on SOC_NRF52832_QFAA
```

## mBeaconSrc/zephyr/boards/arm/mBeacon/Kconfig.defconfig
```kconfig
# nRF52 MBeacon board configuration

if BOARD_MBEACON

config BOARD
	default "mBeacon"

config BT_CTLR
	default BT

endif # BOARD_MBEACON
```
